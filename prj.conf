## CMakeLists.txt
```
cmake_minimum_required(VERSION 3.8.2)

set(BOARD nrf52840_pca10056)
set(Ninja 1)
include($ENV{ZEPHYR_BASE}/cmake/app/boilerplate.cmake NO_POLICY_SCOPE)
project(c_code)

# Generate version file
include(build.version.cmake NO_POLICY_SCOPE)

# Schedule a new version file generation after every build
add_custom_command(
    TARGET app
    POST_BUILD
    COMMAND "${CMAKE_COMMAND}"
    -DPROJECT_SOURCE_DIR=${PROJECT_SOURCE_DIR}
    -DPROJECT_BINARY_DIR=${PROJECT_BINARY_DIR}
    -P ${PROJECT_SOURCE_DIR}/build.version.cmake
    )

list(APPEND HEADERS
    "${PROJECT_BINARY_DIR}/include/generated"
    "${PROJECT_BINARY_DIR}/zephyr/include/generated"
    "${PROJECT_SOURCE_DIR}/include"
    )

list(APPEND SOURCES
    "${PROJECT_SOURCE_DIR}/src/main.cpp"
    "${PROJECT_SOURCE_DIR}/src/firmware_version.cpp"
    "${PROJECT_SOURCE_DIR}/src/msg_manager.cpp"
    "${PROJECT_SOURCE_DIR}/src/msg_handler.cpp"
    "${PROJECT_SOURCE_DIR}/src/sspconf_handler.cpp"
    "${PROJECT_SOURCE_DIR}/src/event_command.cpp"
    )

include_directories(${HEADERS})
target_sources(app PRIVATE ${SOURCES})
```

## prj.conf
```kconfig
CONFIG_CPLUSPLUS=y
CONFIG_GPIO=y

CONFIG_SERIAL=y
CONFIG_STDOUT_CONSOLE=y
CONFIG_UART_INTERRUPT_DRIVEN=y
```

## src/main.cpp
```c
/**
 * @file main.c
 * @author your name (you@domain.com)
 * @brief
 * @version 0.1
 * @date 2018-12-25
 *
 * @copyright Copyright (c) 2018
 *
 */

#include <zephyr/types.h>

#include "firmware_version.h"
#include "msg_manager.h"
#include "sspconf_handler.h"

// uart
#include <misc/byteorder.h>
#include <stdio.h>
#include <uart.h>
#include <zephyr.h>


void uart_callback(struct device *uart_dev)
{
    u8_t recvData;

    if (!uart_irq_update(uart_dev)) {
        printk("UART is not workin properly\n");
        return;
    }

    if (uart_irq_rx_ready(uart_dev)) {
        uart_fifo_read(uart_dev, &recvData, 1);
    }

    MsgManager::instance()->receiveByte((char) recvData);
}


void initUart(struct device *uart_dev)
{
    uart_dev = device_get_binding("UART_3");

    if (uart_dev == nullptr) {
        printk("The UART device was not finded.\n");
        return;
    }

    uart_irq_callback_set(uart_dev, uart_callback);
    uart_irq_rx_enable(uart_dev);
}

class SsppinHandler : public EventCommand
{
   public:
    SsppinHandler(const char *prefix, const char *suffix, const char *init_body,
                  const char *delimiter, u8_t argc)
        : EventCommand(prefix, suffix, init_body, delimiter, argc)
    {
    }
    int resolve()
    {
        printk("The 1 argument from ssppin handler is: %s\n", m_argv[0]);
        printk("The 2 argument from ssppin handler is: %s\n", m_argv[1]);
        return 0;
    }

   protected:
};

class LeattmtuHandler : public EventCommand
{
   public:
    LeattmtuHandler(const char *prefix, const char *suffix, const char *init_body,
                    const char *delimiter, u8_t argc)
        : EventCommand(prefix, suffix, init_body, delimiter, argc)
    {
    }
    int resolve()
    {
        printk("The 1 argument from leattmtu handler is: %s\n", m_argv[0]);
        printk("The 2 argument from leattmtu handler is: %s\n", m_argv[1]);
        return 0;
    }

   protected:
};

void main(void)
{
    printk("Firmware version: %d.%d.%d\n", version_get_major(), version_get_minor(),
            version_get_build());
    SSPCONFHandler sspconf(SSPCONF_PREFIX, SSPCONF_SUFFIX, " ", " ", 3U);
    LeattmtuHandler leattmtu("LEATTMTU", "\r", ":", ",", 2U);
    SsppinHandler ssppin("SSPPIN", "\r", " ", " ", 2U);

    MsgManager::instance()->subscribe(&sspconf);
    MsgManager::instance()->subscribe(&leattmtu);
    MsgManager::instance()->subscribe(&ssppin);
    struct device uart_dev;
    initUart(&uart_dev);

    while (1) {
        k_sleep(1);
    }
}
```

## include/event_command.h
```c
#ifndef _GENERAL_COMMAND_H_
#define _GENERAL_COMMAND_H_


#include <string.h>

#include "msg_handler.h"


enum mount_state { READING_INIT_BODY, READING_PAYLOAD, READING_SUFFIX, END_MSG };

class EventCommand : public MsgHandler
{
   public:
    EventCommand(const char *prefix, const char *suffix, const char *initBody,
                 const char *delimiter, u8_t argc);
    int mountBody(char byte);
    virtual int resolve()
    {
        return -EINVAL;
    }

   protected:
    char m_delimiter[DELIMITER_LENGTH];
    char m_initBody[INIT_BODY_LENGTH];
    mount_state m_state;
    u8_t m_currentChar;
    u8_t m_currentArg;
    u8_t m_suffix_i;
    u8_t m_argc;
    char *m_argv[NUMBER_OF_ARGUMENTS];
    void resetRead();
};

#endif
```

## include/firmware_version.h
```c
/**!
 * @file version.h
 * @author Rodrigo Peixoto (rodrigopex@ic.ufal.br)
 * @brief
 * @version 0.1
 * @date 2018-11-21
 *
 * @copyright Copyright (c) ic.ufal.br 2018
 *
 */
#ifndef _VERSION_H_
#define _VERSION_H_

#include <zephyr/types.h>

#include "current_version.h"


typedef struct {
    u8_t major;
    u8_t minor;
    u16_t build;
} version_t;

const version_t *version_instance();
u8_t version_get_major();
u8_t version_get_minor();
u16_t version_get_build();

#endif  // _IC_VERSION_H_
```

## include/globals.h
```c
#ifndef _GLOBALS_H_
#define _GLOBALS_H_

#include <zephyr.h>

#define PREFIX_LENGTH 15
#define SUFFIX_LENGTH 5
#define BODY_LENGTH 100
#define DELIMITER_LENGTH 5
#define INIT_BODY_LENGTH 5

#define NUMBER_OF_ARGUMENTS 6
#define ARG_LENGTH 40

#endif
```

## include/ic_version.h
```c
/**!
 * @file version.h
 * @author Rodrigo Peixoto (rodrigopex@ic.ufal.br)
 * @brief
 * @version 0.1
 * @date 2018-11-21
 *
 * @copyright Copyright (c) ic.ufal.br 2018
 *
 */
#ifndef _VERSION_H_
#define _VERSION_H_

#include <zephyr/types.h>

#include "firmware_version.h"

typedef struct {
    u8_t major;
    u8_t minor;
    u16_t build;
} version_t;

const version_t *version_instance();
u8_t version_get_major();
u8_t version_get_minor();
u16_t version_get_build();

#endif  // _IC_VERSION_H_
```

## include/msg_handle.h
```c
#ifndef _MSG_HANDLE_H_
#define _MSG_HANDLE_H_

#include <errno.h>
#include <logging/log.h>
#include <misc/printk.h>
#include <zephyr/types.h>

#include "stdlib.h"
#include "string.h"

class MsgHandle
{
   public:
    MsgHandle(const char *prefix, const char *sufix);
    virtual int resolve(char *content)
    {
        return -EINVAL;
    };
    const char *prefix();
    const char *sufix();
    char *splitPick(char *msg, const char *delimiter, u8_t n);
    char *strtok(char *str, const char *delimiter);
    virtual int mountBody(char byte) = 0;

   protected:
    const char *m_prefix;
    const char *m_sufix;
    char m_body[100];
    char *m_temp;
};

#endif
```

## include/msg_handler.h
```c
#ifndef _MSG_HANDLE_H_
#define _MSG_HANDLE_H_

#include <errno.h>
#include <misc/printk.h>
#include <zephyr/types.h>

#include "stdlib.h"
#include "string.h"
#include "globals.h"


class MsgHandler
{
   public:
    MsgHandler(const char *prefix, const char *suffix);
    virtual int resolve()
    {
        return -EINVAL;
    };
    virtual int mountBody(char byte) = 0;
    char *prefix();
    char *suffix();

   protected:
    char m_prefix[PREFIX_LENGTH];
    char m_suffix[SUFFIX_LENGTH];
    char m_body[BODY_LENGTH];
};

#endif
```

## include/msg_manager.h
```c
#ifndef _MSG_MANAGER_H_
#define _MSG_MANAGER_H_

// Includes
#include <misc/printk.h>
#include <zephyr/types.h>

#include "msg_handler.h"
#include "string.h"
#include "globals.h"


// Defines
#define MAX_MSG_HANDLES 16

enum state { NO_MESSAGE, READING_PREFIX, READING_BODY };
enum event { MATCH, NOT_MATCH, PREFIX_COMPLETE, BODY_OK, BODY_BROKEN, NULL_EVENT };

class MsgManager
{
   public:
    int subscribe(MsgHandler *msgHandler);
    void receiveByte(char byte);
    void nextState(event e);
    void resetCandidates();
    char upperCase(char byte);
    static MsgManager *instance()
    {
        return &m_instance;
    }

   private:
    MsgManager()
    {
        for (u8_t i = 0; i < MAX_MSG_HANDLES; i++) {
            m_handles[i] = nullptr;
        }
        m_state = NO_MESSAGE;
    };

    static MsgManager m_instance;
    state m_state;
    u8_t m_i;
    u8_t m_handleIndex;
    u8_t m_candidates[MAX_MSG_HANDLES];
    MsgHandler *m_handles[MAX_MSG_HANDLES];
};

#endif
```

## include/sspconf_handler.h
```c
#ifndef _SSPCONF_HANDLER_H_
#define _SSPCONF_HANDLER_H_

#include <errno.h>
#include <misc/printk.h>
#include <zephyr/types.h>

#include "event_command.h"

#define SSPCONF_PREFIX "SSPCONF"
#define SSPCONF_SUFFIX "---"

class SSPCONFHandler : public EventCommand
{
   public:
    SSPCONFHandler(const char *prefix, const char *suffix, const char *init_body,
                   const char *delimiter, u8_t argc);
    int resolve();

   protected:
    u8_t m_test;
};

#endif
```

## include/sspconf_handler.hpp
```c
#ifndef _SSPCONF_HANDLER_HPP_
#define _SSPCONF_HANDLER_HPP_

#include <errno.h>
#include <misc/printk.h>
#include <zephyr/types.h>

#include "tc_msg_handle.hpp"

#define SSPCONF_PREFIX "SSPCONF"
#define SSPCONF_SUFIX "OK"

class SSPCONFHandler : public MsgHandle
{
   public:
    SSPCONFHandler(const char *prefix, const char *sufix);
    int resolve(char *body);

   protected:
    u8_t m_test;
};

#endif
```

## include/tc_msg_handle.hpp
```c
#ifndef _TC_MSG_HANDLE_HPP_
#define _TC_MSG_HANDLE_HPP_

#include <errno.h>
#include <logging/log.h>
#include <misc/printk.h>
#include <zephyr/types.h>

#include "stdlib.h"
#include "string.h"

class MsgHandle
{
   public:
    MsgHandle(const char *prefix, const char *sufix);
    virtual int resolve(char *content)
    {
        return -EINVAL;
    };
    const char *prefix();
    const char *sufix();
    char *splitPick(char *msg, const char *delimiter, u8_t n);
    char *strtok(char *str, const char *delimiter);
    void payload(char *msg);
    int setMsgLength(const char *msg);

   protected:
    const char *m_prefix;
    const char *m_sufix;
    char m_content[50];
    char *m_temp;
    u8_t m_msgLength;
};

#endif
```

## include/tc_msg_manager.hpp
```c
#ifndef _TC_MSG_MANAGER_HPP_
#define _TC_MSG_MANAGER_HPP_

// Includes
#include <misc/printk.h>
#include <zephyr/types.h>

#include "string.h"
#include "tc_msg_handle.hpp"

// uart
#include <misc/byteorder.h>
#include <stdio.h>
#include <uart.h>
#include <zephyr.h>

// Defines
#define MAX_MSG_HANDLES 10

enum state { NO_MESSAGE, READING_PREFIX, READING_BODY, READING_SUFIX };

class MsgManager
{
   public:
    int handlePrefix(const u8_t *msg, const u8_t *pattern);
    int subscribe(MsgHandle *msgHandle);
    void receiveByte(char byte);
    static MsgManager *instance()
    {
        return &m_instance;
    }

   private:
    MsgManager()
    {
        for (u8_t i = 0; i < MAX_MSG_HANDLES; i++) {
            m_handles[i] = nullptr;
        }
        m_state = NO_MESSAGE;
    };

    static MsgManager m_instance;
    state m_state;
    u8_t m_i;
    u8_t m_handleIndex;
    MsgHandle *m_handles[MAX_MSG_HANDLES];
    char msg[50];
};

#endif
```

## src/event_command.cpp
```c
#include "event_command.h"

EventCommand::EventCommand(const char *prefix, const char *suffix, const char *initBody,
                           const char *delimiter, u8_t argc)
    : MsgHandler(prefix, suffix),
      m_argc(argc)
{
    memset(m_delimiter, 0, DELIMITER_LENGTH);
    strcpy(m_delimiter, delimiter);

    memset(m_initBody, 0, INIT_BODY_LENGTH);
    strcpy(m_initBody, initBody);


    resetRead();
}

int EventCommand::mountBody(char byte)
{
    printk("Mounting the body\n");
    switch (m_state) {
    case READING_INIT_BODY:
        if (m_currentChar == 255) {
            if (byte == m_initBody[0]) {
                m_currentArg++;
                m_currentChar++;
                m_state = READING_PAYLOAD;
                printk("Receiving the first byte\n");
                return 0;
            }
            printk("The message is broken, discarding it\n");
            return -EINVAL;
        }
        break;
    case READING_PAYLOAD:
        if (byte == m_suffix[0]) {
            if (m_currentArg != m_argc) {
                printk("The message is broken, discarding it\n");
                resetRead();
                return -EINVAL;
            }
            m_body[m_currentChar] = '\0';
            m_argv[0]             = (m_body + 0);
            if (strlen(m_suffix) == 1) {
                printk("The message was readed successfuly\n");
                resolve();
                resetRead();
                return END_MSG;
            } else {
                m_state = READING_SUFFIX;
            }
            break;
        }
        if (byte == m_delimiter[0]) {
            m_argv[m_currentArg++]  = (m_body + m_currentChar + 1);
            m_body[m_currentChar++] = '\0';
            printk("Reading a new delimiter, moving to %d° argument\n", m_currentArg);
        } else {
            printk("Adding a new byte to %d° argument\n", m_currentArg);
            m_body[m_currentChar++] = byte;
        }
        break;
    case READING_SUFFIX:
        if (byte != m_suffix[m_suffix_i++]) {
            return -EINVAL;
        }
        if (m_suffix_i == strlen(m_suffix)) {
            printk("The message was readed successfuly\n");
            resolve();
            resetRead();
            return END_MSG;
        }
        break;
    default:
        break;
    };


    return 0;
}

void EventCommand::resetRead()
{
    m_currentChar = 255;
    m_state       = READING_INIT_BODY;
    m_suffix_i    = 1;
    m_currentArg  = 0;
}
```
